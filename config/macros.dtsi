macro_bn: macro_bn{
compatible = "zmk,behavior-macro";
label = "macro_bn";
#binding-cells = <0>;
bindings = <&kp COLON>, <&kp B>, <&kp N>, <&kp ENTER>;
};
macro_bp: macro_bp{
compatible = "zmk,behavior-macro";
label = "macro_bp";
#binding-cells = <0>;
bindings = <&kp COLON>, <&kp B>, <&kp P>, <&kp ENTER>;
};
macro_erm: macro_erm{
compatible = "zmk,behavior-macro";
label = "macro_erm";
#binding-cells = <0>;
bindings = <&macro_press &kp LALT>, <&macro_tap &kp ENTER>, <&macro_release &kp LALT>;
};